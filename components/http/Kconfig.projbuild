## components/http/Kconfig.projbuild
```kconfig
menu "HTTP file server menu"

    menu "WiFi AP Configuration"

        config ESP_WIFI_SSID
            string "AP SSID"
            default "helo i am daq"
            help
                SSID (network name) of the access point.

        config ESP_WIFI_PASSWORD
            string "AP Password"
            default "sawcon"
            help
                Password for the access point. Leave empty for open network.

        config ESP_WIFI_CHANNEL
            int "AP WiFi Channel"
            range 1 13
            default 1
            help
                WiFi channel to use for the access point.

        config ESP_MAX_STA_CONN
            int "Maximum STA connections"
            range 1 10
            default 4
            help
                Maximum number of stations that can connect to the AP.
    endmenu
endmenu
```
